## boards/shields/toucan/Kconfig.defconfig
```kconfig
if SHIELD_TOUCAN_LEFT

config ZMK_KEYBOARD_NAME
    default "Toucan"

config ZMK_SPLIT_ROLE_CENTRAL
    default y

config ZMK_SPLIT_BLE_CENTRAL_BATTERY_LEVEL_FETCHING
    default y

config ZMK_SPLIT_BLE_CENTRAL_BATTERY_LEVEL_PROXY
    default y

config ZMK_STATUS_ADVERTISEMENT
    default y

# config ZMK_STATUS_ADV_KEYBOARD_NAME
#    default "Toucan"

# config ZMK_STATUS_ADV_ACTIVITY_BASED
#    default y

# config ZMK_STATUS_ADV_ACTIVE_INTERVAL_MS
#    default 100

# config ZMK_STATUS_ADV_IDLE_INTERVAL_MS
#    default 30000

endif



if SHIELD_TOUCAN_LEFT || SHIELD_TOUCAN_RIGHT

config SPI
    default y

config ZMK_SPLIT
    default y

config ZMK_POINTING
    default y

config RGBLED_WIDGET_BATTERY_LEVEL_HIGH
    default 40

endif
```
